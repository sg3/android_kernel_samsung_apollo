## arch/arm/mach-s5p6442/Kconfig
```kconfig
# arch/arm/mach-s5p6442/Kconfig
#
# Copyright (c) 2009-2010 Samsung Electronics Co., Ltd.
#		http://www.samsung.com/
#
# Licensed under GPLv2
#
# Originally for S5P64x0 and adapted to S5P6442 by Mark Kennard
#

if ARCH_S5P6442

config CPU_S5P6442
	bool
	select S3C_PL330_DMA
	select S5P_HRT
	help
	  Enable S5P6442 CPU support

config S5P6442_SETUP_I2C1
	bool
	help
	  Common setup code for i2c bus 1.

# machine support

config MACH_APOLLO
	bool "Galaxy Apollo"
	select CPU_S5P6442
	select S3C_DEV_I2C1
	select S3C_DEV_RTC
	select S3C_DEV_WDT
	select S3C64XX_DEV_SPI
	select SAMSUNG_DEV_ADC
	select SAMSUNG_DEV_PWM
	select SAMSUNG_DEV_TS
	select S5P6442_SETUP_I2C1
	help
	  Machine support for the Samsung Galaxy Apollo
endif
```
